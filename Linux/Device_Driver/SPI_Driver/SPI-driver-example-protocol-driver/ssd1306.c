/****************************************************************************//**
*  \file       ssd1306.c
*
*  \details    SSD1306 related functions (SPI)
*
*  \author     EmbeTronicX
*
*  \Tested with Linux raspberrypi 5.10.27-v7l-embetronicx-custom+
*
*******************************************************************************/
#include <linux/gpio.h>     //GPIO
#include <linux/delay.h>

#include "ssd1306.h"

/*
** Variable to store Line Number and Cursor Position.
*/ 
static uint8_t SSD1306_LineNum   = 0;
static uint8_t SSD1306_CursorPos = 0;
static uint8_t SSD1306_FontSize  = SSD1306_DEF_FONT_SIZE;

/*
**  EmbeTronicX Logo
*/
static const uint8_t etx_logo[1024] = {
  0xFF, 0x01, 0x01, 0x01, 0x01, 0x01, 0x01, 0x01, 0x01, 0x01, 0xE1, 0xF9, 0xFF, 0xF9, 0xE1, 0x01,
  0x01, 0x01, 0x01, 0x01, 0x01, 0x01, 0x01, 0x01, 0x01, 0x01, 0x01, 0x01, 0x01, 0x01, 0x01, 0x01,
  0x01, 0x01, 0x01, 0x01, 0x01, 0x01, 0x01, 0x01, 0x01, 0x01, 0x01, 0x01, 0x01, 0x01, 0x01, 0x01,
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  0x84, 0x84, 0x87, 0x80, 0x87, 0x80, 0x87, 0x80, 0x87, 0x85, 0x85, 0x85, 0x80, 0x80, 0x80, 0xFF
};

/*
** Array Variable to store the letters.
*/ 
static const unsigned char SSD1306_font[][SSD1306_DEF_FONT_SIZE]= 
{
    {0x00, 0x00, 0x00, 0x00, 0x00},   // space
    {0x00, 0x00, 0x2f, 0x00, 0x00},   // !
    {0x00, 0x07, 0x00, 0x07, 0x00},   // "
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    {0x00, 0x06, 0x09, 0x09, 0x06}    // ~ (Degrees)
};

/****************************************************************************
 * Name: ETX_SSD1306_ResetDcInit
 *
 * Details : This function Initializes and Configures the Reset and DC Pin
 ****************************************************************************/
static int ETX_SSD1306_ResetDcInit( void )
{
  int ret = 0;
    
  //do while(false) loop to break if any error
  do
  {
    
    /* Register the Reset GPIO */
    
    //Checking the Reset GPIO is valid or not
    if( gpio_is_valid( SSD1306_RST_PIN ) == false )
    {
      pr_err("Reset GPIO %d is not valid\n", SSD1306_RST_PIN);
      ret = -1;
      break;
    }
    
    //Requesting the Reset GPIO
    if( gpio_request( SSD1306_RST_PIN, "SSD1306_RST_PIN" ) < 0 )
    {
      pr_err("ERROR: Reset GPIO %d request\n", SSD1306_RST_PIN);
      ret = -1;
      break;
    }
    
    //configure the Reset GPIO as output
    gpio_direction_output( SSD1306_RST_PIN, 1 );
    
    /* Register the DC GPIO */
    
    //Checking the DC GPIO is valid or not
    if( gpio_is_valid( SSD1306_DC_PIN ) == false )
    {
      pr_err("DC GPIO %d is not valid\n", SSD1306_DC_PIN);
      gpio_free( SSD1306_RST_PIN );   // free the reset GPIO
      ret = -1;
      break;
    }
    
    //Requesting the DC GPIO
    if( gpio_request( SSD1306_DC_PIN, "SSD1306_DC_PIN" ) < 0 )
    {
      pr_err("ERROR: DC GPIO %d request\n", SSD1306_DC_PIN);
      gpio_free( SSD1306_RST_PIN );   // free the reset GPIO
      ret = -1;
      break;
    }
    
    //configure the Reset GPIO as output
    gpio_direction_output( SSD1306_DC_PIN, 1 );
    
  } while( false );
  
  //pr_info("DC Reset GPIOs init Done!\n");
  return( ret );
}

/****************************************************************************
 * Name: ETX_SSD1306_ResetDcDeInit
 *
 * Details : This function De-initializes the Reset and DC Pin
 ****************************************************************************/
static void ETX_SSD1306_ResetDcDeInit( void )
{
  gpio_free( SSD1306_RST_PIN );   // free the reset GPIO
  gpio_free( SSD1306_DC_PIN );    // free the DC GPIO
}

/****************************************************************************
 * Name: ETX_SSD1306_setRst
 *
 * Details : This function writes the value to the Reset GPIO
 * 
 * Argument: 
 *            value - value to be set ( 0 or 1 )
 * 
 ****************************************************************************/
static void ETX_SSD1306_setRst( uint8_t value )
{
  gpio_set_value( SSD1306_RST_PIN, value );
}

/****************************************************************************
 * Name: ETX_SSD1306_setDc
 *
 * Details : This function writes the value to the DC GPIO
 * 
 * Argument: 
 *            value - value to be set ( 0 or 1 )
 * 
 ****************************************************************************/
static void ETX_SSD1306_setDc( uint8_t value )
{
  gpio_set_value( SSD1306_DC_PIN, value );
}

/****************************************************************************
 * Name: ETX_SSD1306_Write
 *
 * Details : This function sends the command/data to the Display
 *
 * Argument: is_cmd
 *              true  - if we need to send command
 *              false - if we need to send data
 *           value
 *              value to be transmitted
 ****************************************************************************/
static int ETX_SSD1306_Write( bool is_cmd, uint8_t data )
{
  int     ret = 0;
  uint8_t pin_value;

  if( is_cmd )
  {
    //DC pin has to be low, if this is command.
    pin_value = 0u;
  }
  else
  {
    //DC pin has to be high, if this is data.
    pin_value = 1u;
  }
  
  ETX_SSD1306_setDc( pin_value );
  
  //pr_info("Writing 0x%02X \n", data);
  
  //send the byte
  ret = etx_spi_write( data );
  
  return( ret );
}

/****************************************************************************
 * Name: ETX_SSD1306_SetCursor
 *
 * Details : This function is specific to the SSD_1306 OLED.
 *
 * Argument:
 *              lineNo    -> Line Number
 *              cursorPos -> Cursor Position
 * 
 ****************************************************************************/
void ETX_SSD1306_SetCursor( uint8_t lineNo, uint8_t cursorPos )
{
  /* Move the Cursor to specified position only if it is in range */
  if((lineNo <= SSD1306_MAX_LINE) && (cursorPos < SSD1306_MAX_SEG))
  {
    SSD1306_LineNum   = lineNo;                 // Save the specified line number
    SSD1306_CursorPos = cursorPos;              // Save the specified cursor position
    
    ETX_SSD1306_Write(true, 0x21);              // cmd for the column start and end address
    ETX_SSD1306_Write(true, cursorPos);         // column start addr
    ETX_SSD1306_Write(true, SSD1306_MAX_SEG-1); // column end addr
    ETX_SSD1306_Write(true, 0x22);              // cmd for the page start and end address
    ETX_SSD1306_Write(true, lineNo);            // page start addr
    ETX_SSD1306_Write(true, SSD1306_MAX_LINE);  // page end addr
  }
}

/****************************************************************************
 * Name: ETX_SSD1306_GoToNextLine
 *
 * Details : This function is specific to the SSD_1306 OLED and move the cursor 
 *           to the next line.
 ****************************************************************************/
void ETX_SSD1306_GoToNextLine( void )
{
  /*
  ** Increment the current line number.
  ** roll it back to first line, if it exceeds the limit. 
  */
  SSD1306_LineNum++;
  SSD1306_LineNum = (SSD1306_LineNum & SSD1306_MAX_LINE);
  ETX_SSD1306_SetCursor(SSD1306_LineNum,0); /* Finally move it to next line */
}

/****************************************************************************
 * Name: ETX_SSD1306_PrintChar
 *
 * Details : This function is specific to the SSD_1306 OLED and sends 
 *           the single char to the OLED.
 * 
 * Arguments:
 *           c   -> character to be written
 * 
 ****************************************************************************/
void ETX_SSD1306_PrintChar( unsigned char c )
{
  uint8_t data_byte;
  uint8_t temp = 0;
  
  /*
  ** If we character is greater than segment len or we got new line charcter
  ** then move the cursor to the new line
  */ 
  if( (( SSD1306_CursorPos + SSD1306_FontSize ) >= SSD1306_MAX_SEG ) ||
      ( c == '\n' )
  )
  {
    ETX_SSD1306_GoToNextLine();
  }
  
  // print charcters other than new line
  if( c != '\n' )
  {
  
    /*
    ** In our font array (SSD1306_font), space starts in 0th index.
    ** But in ASCII table, Space starts from 32 (0x20).
    ** So we need to match the ASCII table with our font table.
    ** We can subtract 32 (0x20) in order to match with our font table.
    */
    c -= 0x20;  //or c -= ' ';
    do
    {
      data_byte= SSD1306_font[c][temp];         // Get the data to be displayed from LookUptable
      ETX_SSD1306_Write(false, data_byte);  // write data to the OLED
      SSD1306_CursorPos++;
      
      temp++;
      
    } while ( temp < SSD1306_FontSize);
    
    ETX_SSD1306_Write(false, 0x00);         //Display the data
    SSD1306_CursorPos++;
  }
}

/****************************************************************************
 * Name: ETX_SSD1306_String
 *
 * Details : This function is specific to the SSD_1306 OLED and sends 
 *           the string to the OLED.
 * 
 * Arguments:
 *           str   -> string to be written
 * 
 ****************************************************************************/
void ETX_SSD1306_String(char *str)
{
  while( *str )
  {
    ETX_SSD1306_PrintChar(*str++);
  }
}


/****************************************************************************
 * Name: ETX_SSD1306_InvertDisplay
 *
 * Details : This function is specific to the SSD_1306 OLED and 
 *           inverts the display.
 * 
 * Arguments:
 *           need_to_invert   -> true  - invert display
 *                               false - normal display 
 * 
 ****************************************************************************/
void ETX_SSD1306_InvertDisplay(bool need_to_invert)
{
  if(need_to_invert)
  {
    ETX_SSD1306_Write(true, 0xA7); // Invert the display
  }
  else
  {
    ETX_SSD1306_Write(true, 0xA6); // Normal display
  }
}

/****************************************************************************
 * Name: ETX_SSD1306_SetBrightness
 *
 * Details : This function is specific to the SSD_1306 OLED and 
 *           sets the brightness of  the display.
 * 
 * Arguments:
 *           brightnessValue   -> brightness value ( 0 - 255 )
 * 
 ****************************************************************************/
void ETX_SSD1306_SetBrightness(uint8_t brightnessValue)
{
    ETX_SSD1306_Write(true, 0x81);            // Contrast command
    ETX_SSD1306_Write(true, brightnessValue); // Contrast value (default value = 0x7F)
}

/****************************************************************************
 * Name: ETX_SSD1306_StartScrollHorizontal
 *
 * Details : This function is specific to the SSD_1306 OLED and 
 *           Scrolls the data right/left in horizontally.
 * 
 * Arguments:
 *           is_left_scroll   -> true  - left horizontal scroll
 *                               false - right horizontal scroll
 *           start_line_no    -> Start address of the line to scroll 
 *           end_line_no      -> End address of the line to scroll 
 * 
 ****************************************************************************/
void ETX_SSD1306_StartScrollHorizontal( bool is_left_scroll,
                                        uint8_t start_line_no,
                                        uint8_t end_line_no
                                      )
{
  if(is_left_scroll)
  {
    // left horizontal scroll
    ETX_SSD1306_Write(true, 0x27);
  }
  else
  {
    // right horizontal scroll 
    ETX_SSD1306_Write(true, 0x26);
  }
  
  ETX_SSD1306_Write(true, 0x00);            // Dummy byte (dont change)
  ETX_SSD1306_Write(true, start_line_no);   // Start page address
  ETX_SSD1306_Write(true, 0x00);            // 5 frames interval
  ETX_SSD1306_Write(true, end_line_no);     // End page address
  ETX_SSD1306_Write(true, 0x00);            // Dummy byte (dont change)
  ETX_SSD1306_Write(true, 0xFF);            // Dummy byte (dont change)
  ETX_SSD1306_Write(true, 0x2F);            // activate scroll
}

/****************************************************************************
 * Name: ETX_SSD1306_StartScrollVerticalHorizontal
 *
 * Details : This function is specific to the SSD_1306 OLED and 
 *           Scrolls the data in vertically and right/left horizontally
 *           (Diagonally).
 * 
 * Arguments:
 *      is_vertical_left_scroll -> true  - vertical and left horizontal scroll
 *                                 false - vertical and right horizontal scroll
 *      start_line_no           -> Start address of the line to scroll 
 *      end_line_no             -> End address of the line to scroll 
 *      vertical_area           -> Area for vertical scroll (0-63)
 *      rows                    -> Number of rows to scroll vertically 
 * 
 ****************************************************************************/
void ETX_SSD1306_StartScrollVerticalHorizontal( 
                                                bool is_vertical_left_scroll,
                                                uint8_t start_line_no,
                                                uint8_t end_line_no,
                                                uint8_t vertical_area,
                                                uint8_t rows
                                              )
{
  
  ETX_SSD1306_Write(true, 0xA3);            // Set Vertical Scroll Area
  ETX_SSD1306_Write(true, 0x00);            // Check datasheet
  ETX_SSD1306_Write(true, vertical_area);   // area for vertical scroll
  
  if(is_vertical_left_scroll)
  {
    // vertical and left horizontal scroll
    ETX_SSD1306_Write(true, 0x2A);
  }
  else
  {
    // vertical and right horizontal scroll 
    ETX_SSD1306_Write(true, 0x29);
  }
  
  ETX_SSD1306_Write(true, 0x00);            // Dummy byte (dont change)
  ETX_SSD1306_Write(true, start_line_no);   // Start page address
  ETX_SSD1306_Write(true, 0x00);            // 5 frames interval
  ETX_SSD1306_Write(true, end_line_no);     // End page address
  ETX_SSD1306_Write(true, rows);            // Vertical scrolling offset
  ETX_SSD1306_Write(true, 0x2F);            // activate scroll
}

/****************************************************************************
 * Name: ETX_SSD1306_DeactivateScroll
 *
 * Details : This function disables the scroll.
 ****************************************************************************/
void ETX_SSD1306_DeactivateScroll( void )
{
  ETX_SSD1306_Write(true, 0x2E); // Deactivate scroll
}

/****************************************************************************
 * Name: ETX_SSD1306_fill
 *
 * Details : This function fills the data to the Display
 ****************************************************************************/
void ETX_SSD1306_fill( uint8_t data )
{
  // 8 pages x 128 segments x 8 bits of data
  unsigned int total  = ( SSD1306_MAX_SEG * (SSD1306_MAX_LINE + 1) );
  unsigned int i      = 0;
  
  //Fill the Display
  for(i = 0; i < total; i++)
  {
    ETX_SSD1306_Write(false, data);
  }
}

/****************************************************************************
 * Name: ETX_SSD1306_ClearDisplay
 *
 * Details : This function clears the Display
 ****************************************************************************/
void ETX_SSD1306_ClearDisplay( void )
{
  //Set cursor
  ETX_SSD1306_SetCursor(0,0);
  
  ETX_SSD1306_fill( 0x00 );
}

/****************************************************************************
 * Name: ETX_SSD1306_PrintLogo
 *
 * Details : This function prints the EmbeTronicX Logo
 ****************************************************************************/
void ETX_SSD1306_PrintLogo( void )
{
  int i;
  
  //Set cursor
  ETX_SSD1306_SetCursor(0,0);
  
  for( i = 0; i < ( SSD1306_MAX_SEG * (SSD1306_MAX_LINE + 1) ); i++ )
  {
    ETX_SSD1306_Write(false, etx_logo[i]);
  }
}

/****************************************************************************
 * Name: ETX_SSD1306_DisplayInit
 *
 * Details : This function Initializes the Display
 ****************************************************************************/
int ETX_SSD1306_DisplayInit(void)
{
  int ret = 0;
  
  //Initialize the Reset and DC GPIOs
  ret = ETX_SSD1306_ResetDcInit();
  
  if( ret >= 0 )
  {
    //Make the RESET Line to 0
    ETX_SSD1306_setRst( 0u );
    msleep(100);                          // delay
    //Make the DC Line to 1
    ETX_SSD1306_setRst( 1u );
    msleep(100);                          // delay
    
    /*
    ** Commands to initialize the SSD_1306 OLED Display
    */
    ETX_SSD1306_Write(true, 0xAE); // Entire Display OFF
    ETX_SSD1306_Write(true, 0xD5); // Set Display Clock Divide Ratio and Oscillator Frequency
    ETX_SSD1306_Write(true, 0x80); // Default Setting for Display Clock Divide Ratio and Oscillator Frequency that is recommended
    ETX_SSD1306_Write(true, 0xA8); // Set Multiplex Ratio
    ETX_SSD1306_Write(true, 0x3F); // 64 COM lines
    ETX_SSD1306_Write(true, 0xD3); // Set display offset
    ETX_SSD1306_Write(true, 0x00); // 0 offset
    ETX_SSD1306_Write(true, 0x40); // Set first line as the start line of the display
    ETX_SSD1306_Write(true, 0x8D); // Charge pump
    ETX_SSD1306_Write(true, 0x14); // Enable charge dump during display on
    ETX_SSD1306_Write(true, 0x20); // Set memory addressing mode
    ETX_SSD1306_Write(true, 0x00); // Horizontal addressing mode
    ETX_SSD1306_Write(true, 0xA1); // Set segment remap with column address 127 mapped to segment 0
    ETX_SSD1306_Write(true, 0xC8); // Set com output scan direction, scan from com63 to com 0
    ETX_SSD1306_Write(true, 0xDA); // Set com pins hardware configuration
    ETX_SSD1306_Write(true, 0x12); // Alternative com pin configuration, disable com left/right remap
    ETX_SSD1306_Write(true, 0x81); // Set contrast control
    ETX_SSD1306_Write(true, 0x80); // Set Contrast to 128
    ETX_SSD1306_Write(true, 0xD9); // Set pre-charge period
    ETX_SSD1306_Write(true, 0xF1); // Phase 1 period of 15 DCLK, Phase 2 period of 1 DCLK
    ETX_SSD1306_Write(true, 0xDB); // Set Vcomh deselect level
    ETX_SSD1306_Write(true, 0x20); // Vcomh deselect level ~ 0.77 Vcc
    ETX_SSD1306_Write(true, 0xA4); // Entire display ON, resume to RAM content display
    ETX_SSD1306_Write(true, 0xA6); // Set Display in Normal Mode, 1 = ON, 0 = OFF
    ETX_SSD1306_Write(true, 0x2E); // Deactivate scroll
    ETX_SSD1306_Write(true, 0xAF); // Display ON in normal mode
    
    // Clear the display
    ETX_SSD1306_ClearDisplay();
  }
    
  return( ret );
}

/****************************************************************************
 * Name: ETX_SSD1306_DisplayDeInit
 *
 * Details : This function De-initializes the Display
 ****************************************************************************/
void ETX_SSD1306_DisplayDeInit(void)
{
  ETX_SSD1306_ResetDcDeInit();  //Free the Reset and DC GPIO
}
